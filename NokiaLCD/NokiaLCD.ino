//LCD code from Adafruit
//buzzer code from http://www.multiwingspan.co.uk/arduino.php?page=buzzer3

#include <SPI.h>
#include <Adafruit_GFX.h>
#include <Adafruit_PCD8544.h>
#include "note.h"

// Software SPI (slower updates, more flexible pin options):
// pin 7 - Serial clock out (SCLK)
// pin 6 - Serial data out (DIN)
// pin 5 - Data/Command select (D/C)
// pin 4 - LCD chip select (CS)
// pin 3 - LCD reset (RST)
Adafruit_PCD8544 display = Adafruit_PCD8544(7, 6, 5, 4, 3);

// Hardware SPI (faster, but must use certain hardware pins):
// SCK is LCD serial clock (SCLK) - this is pin 13 on Arduino Uno
// MOSI is LCD DIN - this is pin 11 on an Arduino Uno
// pin 5 - Data/Command select (D/C)
// pin 4 - LCD chip select (CS)
// pin 3 - LCD reset (RST)
// Adafruit_PCD8544 display = Adafruit_PCD8544(5, 4, 3);
// Note with hardware SPI MISO and SS pins aren't used but will still be read
// and written to during SPI transfer.  Be careful sharing these pins!

const int backlightPin = 9;

const int rest = 0;
const int buzzerPin = 8;
int tempo = 150;

int tune[] = {n_A3, n_B3, n_C4, n_G3, n_G3, n_D4, 0, n_C4, n_A3, n_A3, n_A3, n_A3, n_B3, n_C4};
int beats[] = { 1, 2, 8, 1, 2, 8, 2, 2, 1, 1, 2, 2, 2, 8};
int tunelength = 14;

#define NUMFLAKES 10
#define XPOS 0
#define YPOS 1
#define DELTAY 2

#define LOGO16_GLCD_HEIGHT 16
#define LOGO16_GLCD_WIDTH  16

static const unsigned char PROGMEM logo16_glcd_bmp[] =
{
0x0,0x0,
0xa,0x50,
0xe,0x70,
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0x0,0x0
};
  
static const unsigned char PROGMEM dandandin_bmp[] =
{
0x0,0x0,0x0,0x0,0x0,0x0,0x0,0x0,0x0,0x0,0x0,
0x0,0x0,0x0,0x0,0x0,0x0,0x0,0x0,0x0,0x0,0x0,
0x0,0x0,0x0,0x0,0x0,0x0,0x0,0x0,0x0,0x0,0x0,
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0x0,0x0,0x0,0x0,0x0,0x0,0x0,0x0,0x0,0x0,0x0
};

void setup() {
  pinMode(buzzerPin, OUTPUT);
  pinMode(backlightPin, OUTPUT);
  // put your setup code here, to run once:
  display.begin();
  // init done

  // you can change the contrast around to adapt the display
  // for the best viewing!
  display.setContrast(60);

  //display.display(); // show splashscreen
  //delay(2000);
  display.clearDisplay();   // clears the screen and buffer

  display.drawBitmap(0, 0, dandandin_bmp, 84, 48, BLACK);
  display.display();
  for (int i =0;i<tunelength;i++)
  {
    if (tune[i]==rest)
    {
      delay(beats[i]*tempo);
    } 
    else
    {
      tone(buzzerPin, tune[i], beats[i]*tempo);
      delay(beats[i]*tempo); 
    }
    delay(tempo/10);
  }
  //delay(5000);
  display.clearDisplay();
  
  digitalWrite(backlightPin, HIGH);
  display.setTextSize(1);
  display.setTextColor(BLACK);
  display.setCursor(0,0);
  display.println("Let it goooo");
  display.setTextColor(WHITE, BLACK); // 'inverted' text
  display.setTextSize(2);
  display.println("Let it");
  display.setTextSize(3);
  display.setTextColor(BLACK);
  display.print("gooo");
  display.display();
  delay(5000);
  display.clearDisplay();
  
  digitalWrite(backlightPin, LOW);

  // draw a bitmap icon and 'animate' movement
  testdrawbitmap(logo16_glcd_bmp, LOGO16_GLCD_WIDTH, LOGO16_GLCD_HEIGHT);

}

void loop() {
  // put your main code here, to run repeatedly:

}

void testdrawbitmap(const uint8_t *bitmap, uint8_t w, uint8_t h) {
  uint8_t icons[NUMFLAKES][3];
  srandom(666);     // whatever seed
 
  // initialize
  for (uint8_t f=0; f< NUMFLAKES; f++) {
    icons[f][XPOS] = random() % display.width();
    icons[f][YPOS] = 0;
    icons[f][DELTAY] = random() % 5 + 1;
    
    Serial.print("x: ");
    Serial.print(icons[f][XPOS], DEC);
    Serial.print(" y: ");
    Serial.print(icons[f][YPOS], DEC);
    Serial.print(" dy: ");
    Serial.println(icons[f][DELTAY], DEC);
  }

  while (1) {
    // draw each icon
    for (uint8_t f=0; f< NUMFLAKES; f++) {
      display.drawBitmap(icons[f][XPOS], icons[f][YPOS], logo16_glcd_bmp, w, h, BLACK);
    }
    display.display();
    //delay(200);
    
    // then erase it + move it
    for (uint8_t f=0; f< NUMFLAKES; f++) {
      display.drawBitmap(icons[f][XPOS], icons[f][YPOS],  logo16_glcd_bmp, w, h, WHITE);
      // move it
      icons[f][YPOS] += icons[f][DELTAY];
      // if its gone, reinit
      if (icons[f][YPOS] > display.height()) {
	icons[f][XPOS] = random() % display.width();
	icons[f][YPOS] = 0;
	icons[f][DELTAY] = random() % 5 + 1;
      }
    }
   }
}
